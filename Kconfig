## Kconfig
```kconfig
#
# Copyright (C) 2020 Xiaomi Corporation
#
# Licensed under the Apache License, Version 2.0 (the "License");
# you may not use this file except in compliance with the License.
# You may obtain a copy of the License at
#
#      http://www.apache.org/licenses/LICENSE-2.0
#
# Unless required by applicable law or agreed to in writing, software
# distributed under the License is distributed on an "AS IS" BASIS,
# WITHOUT WARRANTIES OR CONDITIONS OF ANY KIND, either express or implied.
# See the License for the specific language governing permissions and
# limitations under the License.
#

config CHARGE_MANAGER
    tristate "charge manager"
    depends on BATTERY_CHARGER
    select UORB
    default n

if CHARGE_MANAGER

config CHARGE_MANAGER_PRIORITY
    int "task priority"
    default 100

config CHARGE_MANAGER_STACKSIZE
    int "stack size"
    default DEFAULT_TASK_STACKSIZE

config CHARGE_MANAGER_PROGRAM_NAME
    string "charge manager program name"
    default "healthd"

endif # CHARGE_MANAGER
```
